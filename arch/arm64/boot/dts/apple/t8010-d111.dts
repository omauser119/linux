// SPDX-License-Identifier: GPL-2.0+ OR MIT
/*
 * Apple iPhone 7 Plus (Intel), D111, iPhone9,4 (A1661/A1784/A1785/A1786)
 * Copyright (c) 2022, Konrad Dybcio <konradybcio@kernel.org>
 */

/dts-v1/;

#include "t8010-7.dtsi"

/ {
	compatible = "apple,d111", "apple,t8010", "apple,arm-platform";
	model = "Apple iPhone 7 Plus (Intel)";

	reserved-memory {
		/* HX/H9P PCIe SART scratch area. */
		nvme_scratch: nvme-scratch@8bee00000 {
			reg = <0x8 0xbee00000 0 0x01200000>;
			no-map;
		};
	};
};
