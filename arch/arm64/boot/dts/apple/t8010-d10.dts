// SPDX-License-Identifier: GPL-2.0+ OR MIT
/*
 * Apple iPhone 7 (Qualcomm), D10, iPhone9,1 (A1660/A1778/A1779/A1780)
 * Copyright (c) 2022, Konrad Dybcio <konradybcio@kernel.org>
 */

/dts-v1/;

#include "t8010-7.dtsi"

/ {
	compatible = "apple,d10", "apple,t8010", "apple,arm-platform";
	model = "Apple iPhone 7 (Qualcomm)";

	reserved-memory {
		/* HX/H9P PCIe SART scratch area. */
		nvme_scratch: nvme-scratch@87ee00000 {
			reg = <0x8 0x7ee00000 0 0x01200000>;
			no-map;
		};
	};
};
