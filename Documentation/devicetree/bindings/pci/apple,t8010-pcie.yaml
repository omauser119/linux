## Documentation/devicetree/bindings/pci/apple,t8010-pcie.yaml
```yaml
# SPDX-License-Identifier: (GPL-2.0-only OR BSD-2-Clause)
%YAML 1.2
---
$id: http://devicetree.org/schemas/pci/apple,t8010-pcie.yaml#
$schema: http://devicetree.org/meta-schemas/core.yaml#

title: Apple T8010 (A10/H9P) PCIe host controller

description: |
  T8010 has a PCIe NVMe root port with an NVMMU and SART. The SART maps a
  reserved scratch region at a fixed IOVA for the storage controller.

maintainers:
  - omauser119 <329457178+omauser119@users.noreply.github.com>

properties:
  compatible:
    const: apple,t8010-pcie

  reg:
    minItems: 7
    maxItems: 7

  reg-names:
    items:
      - const: config
      - const: rc
      - const: port0
      - const: phy1
      - const: phy2
      - const: sart
      - const: pwr

  interrupts:
    maxItems: 1

  msi-controller: true
  msi-parent: true
  msi-ranges:
    maxItems: 1

  iommu-map: true
  memory-region:
    maxItems: 1

  apple,scratch-iova:
    $ref: /schemas/types.yaml#/definitions/uint32
    description: PCIe SART IOVA corresponding to memory-region

  power-domains:
    minItems: 3
    maxItems: 3

  power-domain-names:
    items:
      - const: ref
      - const: aux
      - const: core

  pinctrl-0: true
  pinctrl-names: true
  debug-gpios:
    maxItems: 1

required:
  - compatible
  - reg
  - reg-names
  - interrupts
  - msi-controller
  - msi-parent
  - msi-ranges
  - iommu-map
  - memory-region
  - apple,scratch-iova
  - power-domains
  - power-domain-names

allOf:
  - $ref: /schemas/pci/pci-host-bridge.yaml#
  - $ref: /schemas/interrupt-controller/msi-controller.yaml#

unevaluatedProperties: false
```
